#include "TestMaterial.h"
#include <Arduino.h>
#include "Filters.h"
#include "Filters/Butterworth.hpp"

float F32SignalSample_TP8_Seg0_S1 [1][1000] = {
        {
        -0.31370868,  0.        , -0.31370868,  0.        , -0.31370868,
         0.        , -0.31370868,  0.        , -0.31370868,  0.        ,
        -0.31370868,  0.        , -0.31370868,  0.        , -0.31370868,
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         0.        , -0.31370868,  0.        , -0.31370868,  0.        
        }
};

float aFSciEegData[1][1000];


void App_TestMaterial(void)
{
    char cMsg[100];
    while(1)
    {
        memset(aFSciEegData, 0, 1*1000);

        // Data Converter
        for(uint16_t u8SampleCnt = 0; u8SampleCnt < 1000; u8SampleCnt++)
        {
            // mV Scale with Low-pass ButterWorth Filter
            aFSciEegData[0][u8SampleCnt] = F32SignalSample_TP8_Seg0_S1[0][u8SampleCnt] * 1;

        }

        // Filter 
        double dFs = 1000; // Hz
        double dFc = 60; // Hz
        double dFn = 2 * dFc / dFs; // Normalized cut-off frequency
        
        auto filter = butter<5>(dFn); // Sixth-order Butterworth filter (Low-pass)

        for(uint16_t u8SampleCnt = 0; u8SampleCnt < 1000; u8SampleCnt++)
        {
            aFSciEegData[0][u8SampleCnt] = filter(aFSciEegData[0][u8SampleCnt]);
        }

        // Baseline Correction 

        double dSignalSum = 0;
        for(uint16_t u8SampleCnt = 0; u8SampleCnt < 1000; u8SampleCnt++)
        {
           dSignalSum += aFSciEegData[0][u8SampleCnt];
        }
        for(uint16_t u8SampleCnt = 0; u8SampleCnt < 1000; u8SampleCnt++)
        {
           aFSciEegData[0][u8SampleCnt] -= (float)(dSignalSum/1000);
        }

        // Multiplying Hanning Window
        double dHanningPointMultiplier = 0;
        for(uint16_t u8SampleCnt = 0; u8SampleCnt < 1000; u8SampleCnt++)
        {
            dHanningPointMultiplier = 0.5 * (1 - cos(2*PI*u8SampleCnt/(1000-1)));
            aFSciEegData[0][u8SampleCnt] = aFSciEegData[0][u8SampleCnt] * dHanningPointMultiplier;
        }

        for(uint16_t u8SampleCnt = 0; u8SampleCnt < 1000; u8SampleCnt++)
        {
            sprintf(cMsg, "%f", aFSciEegData[0][u8SampleCnt]);
            Serial.print(cMsg);
            Serial.print(",");
        }
        Serial.print("\r\n");

        delay(5000);

    }
    
}